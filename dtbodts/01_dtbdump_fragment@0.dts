/dts-v1/;

/ {

	__fixups__ {
		accdet = "/fragment@17:target:0";
		audgpio = "/fragment@21:target:0";
		auxadc = "/fragment@32:target:0";
		bpibus_ctrl = "/fragment@31:target:0";
		chosen = "/fragment@4:target:0";
		consys = "/fragment@13:target:0";
		dsi_te = "/fragment@50:target:0";
		flashlights_constant_gpio = "/fragment@20:target:0";
		gpio = "/fragment@45:target:0";
		gpio_usage_mapping = "/fragment@44:target:0";
		gse_1 = "/fragment@49:target:0";
		i2c0 = "/fragment@34:target:0";
		i2c1 = "/fragment@6:target:0\0/fragment@14:target:0\0/fragment@15:target:0\0/fragment@35:target:0";
		i2c2 = "/fragment@7:target:0\0/fragment@36:target:0";
		i2c3 = "/fragment@37:target:0";
		i2c4 = "/fragment@38:target:0";
		i2c5 = "/fragment@8:target:0\0/fragment@39:target:0";
		i2c6 = "/fragment@9:target:0\0/fragment@40:target:0";
		i2c7 = "/fragment@41:target:0";
		i2c8 = "/fragment@42:target:0";
		i2c9 = "/fragment@43:target:0";
		icnfpsensor = "/fragment@0:target:0\0/fragment@2:target:0";
		irq_nfc = "/fragment@47:target:0";
		kd_camera_hw1 = "/fragment@24:target:0\0/fragment@61:target:0";
		keypad = "/fragment@63:target:0";
		lcd_id_node = "/fragment@28:target:0";
		main_pmic = "/fragment@52:target:0";
		md1_sim1_hot_plug_eint = "/fragment@53:target:0";
		md1_sim2_hot_plug_eint = "/fragment@54:target:0";
		msdc1 = "/fragment@29:target:0";
		msdc1_ins = "/fragment@48:target:0";
		mt_pmic_vcama_ldo_reg = "/fragment@24/__overlay__:cam2_vcama-supply:0\0/fragment@55:target:0\0/fragment@61/__overlay__:vcama-supply:0\0/fragment@61/__overlay__:vcama_sub-supply:0\0/fragment@61/__overlay__:vcama_main2-supply:0";
		mt_pmic_vcamd_ldo_reg = "/fragment@24/__overlay__:cam0_vcamd-supply:0\0/fragment@24/__overlay__:cam1_vcamd-supply:0\0/fragment@24/__overlay__:cam2_vcamd-supply:0\0/fragment@58:target:0\0/fragment@61/__overlay__:vcamd-supply:0\0/fragment@61/__overlay__:vcamd_sub-supply:0\0/fragment@61/__overlay__:vcamd_main2-supply:0";
		mt_pmic_vcamio_ldo_reg = "/fragment@24/__overlay__:cam0_vcamio-supply:0\0/fragment@24/__overlay__:cam1_vcamio-supply:0\0/fragment@24/__overlay__:cam2_vcamio-supply:0\0/fragment@59:target:0\0/fragment@61/__overlay__:vcamio-supply:0\0/fragment@61/__overlay__:vcamio_sub-supply:0\0/fragment@61/__overlay__:vcamio_main2-supply:0";
		mt_pmic_vldo28_ldo_reg = "/fragment@60:target:0\0/fragment@61/__overlay__:vcamaf-supply:0\0/fragment@61/__overlay__:vcamaf_sub-supply:0\0/fragment@61/__overlay__:vcamaf_main2-supply:0\0/fragment@62/__overlay__:vtouch-supply:0";
		mt_pmic_vsim1_ldo_reg = "/fragment@56:target:0";
		mt_pmic_vsim2_ldo_reg = "/fragment@57:target:0";
		mtkfb = "/fragment@26:target:0";
		nfc = "/fragment@27:target:0";
		odm = "/fragment@5:target:0";
		otg_iddig = "/fragment@51:target:0";
		pio = "/fragment@0/__overlay__:interrupt-parent:0\0/fragment@1:target:0\0/fragment@10/__overlay__:touch,int-lead-gpio:0\0/fragment@11:target:0\0/fragment@12:target:0\0/fragment@16:target:0\0/fragment@18:target:0\0/fragment@19:target:0\0/fragment@22:target:0\0/fragment@23:target:0\0/fragment@25:target:0\0/fragment@27/__overlay__:gpio-rst-std:0\0/fragment@27/__overlay__:gpio-irq-std:0\0/fragment@28/__overlay__:gpio_lcd_id:0\0/fragment@28/__overlay__:gpio_wifi_en:0\0/fragment@28/__overlay__:gpio_lcm_enp:0\0/fragment@28/__overlay__:gpio_lcm_enn:0\0/fragment@28/__overlay__:gpio_charge_en:0\0/fragment@28/__overlay__:gpio_otg_en:0\0/fragment@29/__overlay__:cd-gpios:0\0/fragment@30:target:0\0/fragment@35/__overlay__/alsps@51:interrupt-parent:0\0/fragment@44/__overlay__:GPIO_SIM2_SIO:0\0/fragment@44/__overlay__:GPIO_SIM2_SRST:0\0/fragment@44/__overlay__:GPIO_SIM2_SCLK:0\0/fragment@44/__overlay__:GPIO_SIM1_SCLK:0\0/fragment@44/__overlay__:GPIO_SIM1_SRST:0\0/fragment@44/__overlay__:GPIO_SIM1_SIO:0\0/fragment@44/__overlay__:GPIO_SIM2_HOT_PLUG:0\0/fragment@44/__overlay__:GPIO_SIM1_HOT_PLUG:0\0/fragment@44/__overlay__:GPIO_FDD_BAND_SUPPORT_DETECT_1ST_PIN:0\0/fragment@46/__overlay__:interrupt-parent:0\0/fragment@47/__overlay__:interrupt-parent:0\0/fragment@48/__overlay__:interrupt-parent:0\0/fragment@48/__overlay__:deb-gpios:0\0/fragment@49/__overlay__:interrupt-parent:0\0/fragment@50/__overlay__:interrupt-parent:0\0/fragment@51/__overlay__:interrupt-parent:0\0/fragment@52/__overlay__:interrupt-parent:0";
		pmic_clock_buffer_ctrl = "/fragment@33:target:0";
		spi0 = "/fragment@3:target:0";
		touch = "/fragment@10:target:0\0/fragment@46:target:0\0/fragment@62:target:0";
	};

	__local_fixups__ {

		fragment@10 {

			__overlay__ {
				pinctrl-0 = <0x00>;
				pinctrl-1 = <0x00>;
				pinctrl-2 = <0x00>;
				pinctrl-3 = <0x00>;
				pinctrl-4 = <0x00>;
				pinctrl-5 = <0x00>;
			};
		};

		fragment@13 {

			__overlay__ {
				pinctrl-0 = <0x00>;
				pinctrl-1 = <0x00>;
				pinctrl-2 = <0x00>;
				pinctrl-3 = <0x00>;
			};
		};

		fragment@17 {

			__overlay__ {
				pinctrl-0 = <0x00>;
				pinctrl-1 = <0x00>;
			};
		};

		fragment@2 {

			__overlay__ {
				pinctrl-0 = <0x00>;
				pinctrl-1 = <0x00>;
				pinctrl-10 = <0x00>;
				pinctrl-11 = <0x00>;
				pinctrl-12 = <0x00>;
				pinctrl-13 = <0x00>;
				pinctrl-14 = <0x00>;
				pinctrl-15 = <0x00>;
				pinctrl-2 = <0x00>;
				pinctrl-3 = <0x00>;
				pinctrl-4 = <0x00>;
				pinctrl-5 = <0x00>;
				pinctrl-6 = <0x00>;
				pinctrl-7 = <0x00>;
				pinctrl-8 = <0x00>;
				pinctrl-9 = <0x00>;
			};
		};

		fragment@20 {

			__overlay__ {
				pinctrl-0 = <0x00>;
				pinctrl-1 = <0x00>;
				pinctrl-2 = <0x00>;
				pinctrl-3 = <0x00>;
				pinctrl-4 = <0x00>;
				pinctrl-5 = <0x00>;
				pinctrl-6 = <0x00>;
			};
		};

		fragment@21 {

			__overlay__ {
				pinctrl-0 = <0x00>;
				pinctrl-1 = <0x00>;
				pinctrl-10 = <0x00>;
				pinctrl-11 = <0x00>;
				pinctrl-2 = <0x00>;
				pinctrl-3 = <0x00>;
				pinctrl-4 = <0x00>;
				pinctrl-5 = <0x00>;
				pinctrl-6 = <0x00>;
				pinctrl-7 = <0x00>;
				pinctrl-8 = <0x00>;
				pinctrl-9 = <0x00>;
			};
		};

		fragment@24 {

			__overlay__ {
				pinctrl-0 = <0x00>;
				pinctrl-1 = <0x00>;
				pinctrl-10 = <0x00>;
				pinctrl-11 = <0x00>;
				pinctrl-12 = <0x00>;
				pinctrl-13 = <0x00>;
				pinctrl-14 = <0x00>;
				pinctrl-15 = <0x00>;
				pinctrl-16 = <0x00>;
				pinctrl-17 = <0x00>;
				pinctrl-18 = <0x00>;
				pinctrl-19 = <0x00>;
				pinctrl-2 = <0x00>;
				pinctrl-20 = <0x00>;
				pinctrl-21 = <0x00>;
				pinctrl-22 = <0x00>;
				pinctrl-23 = <0x00>;
				pinctrl-24 = <0x00>;
				pinctrl-25 = <0x00>;
				pinctrl-26 = <0x00>;
				pinctrl-27 = <0x00>;
				pinctrl-28 = <0x00>;
				pinctrl-3 = <0x00>;
				pinctrl-4 = <0x00>;
				pinctrl-5 = <0x00>;
				pinctrl-6 = <0x00>;
				pinctrl-7 = <0x00>;
				pinctrl-8 = <0x00>;
				pinctrl-9 = <0x00>;
			};
		};

		fragment@26 {

			__overlay__ {
				pinctrl-0 = <0x00>;
				pinctrl-1 = <0x00>;
			};
		};

		fragment@31 {

			__overlay__ {
				pinctrl-0 = <0x00>;
				pinctrl-1 = <0x00>;
				pinctrl-10 = <0x00>;
				pinctrl-11 = <0x00>;
				pinctrl-12 = <0x00>;
				pinctrl-13 = <0x00>;
				pinctrl-14 = <0x00>;
				pinctrl-15 = <0x00>;
				pinctrl-16 = <0x00>;
				pinctrl-17 = <0x00>;
				pinctrl-18 = <0x00>;
				pinctrl-19 = <0x00>;
				pinctrl-2 = <0x00>;
				pinctrl-20 = <0x00>;
				pinctrl-21 = <0x00>;
				pinctrl-22 = <0x00>;
				pinctrl-23 = <0x00>;
				pinctrl-24 = <0x00>;
				pinctrl-25 = <0x00>;
				pinctrl-26 = <0x00>;
				pinctrl-27 = <0x00>;
				pinctrl-28 = <0x00>;
				pinctrl-29 = <0x00>;
				pinctrl-3 = <0x00>;
				pinctrl-30 = <0x00>;
				pinctrl-31 = <0x00>;
				pinctrl-32 = <0x00>;
				pinctrl-33 = <0x00>;
				pinctrl-34 = <0x00>;
				pinctrl-35 = <0x00>;
				pinctrl-36 = <0x00>;
				pinctrl-4 = <0x00>;
				pinctrl-5 = <0x00>;
				pinctrl-6 = <0x00>;
				pinctrl-7 = <0x00>;
				pinctrl-8 = <0x00>;
				pinctrl-9 = <0x00>;
			};
		};

		fragment@6 {

			__overlay__ {

				alsps@51 {
					pinctrl-0 = <0x00>;
					pinctrl-1 = <0x00>;
				};
			};
		};
	};

	__symbols__ {
		accdet_pins_default = "/fragment@18/__overlay__/accdetdefault";
		accdet_pins_eint_as_int = "/fragment@18/__overlay__/accdeteint@0";
		alsps_intpin_cfg = "/fragment@16/__overlay__/alspspincfg";
		alsps_intpin_default = "/fragment@16/__overlay__/alspsdefaultcfg";
		alsps_mtk = "/fragment@35/__overlay__/alsps@51";
		aud_clk_miso_off = "/fragment@22/__overlay__/aud_clk_miso_off";
		aud_clk_miso_on = "/fragment@22/__overlay__/aud_clk_miso_on";
		aud_clk_mosi_off = "/fragment@22/__overlay__/aud_clk_mosi_off";
		aud_clk_mosi_on = "/fragment@22/__overlay__/aud_clk_mosi_on";
		aud_dat_miso_off = "/fragment@22/__overlay__/aud_dat_miso_off";
		aud_dat_miso_on = "/fragment@22/__overlay__/aud_dat_miso_on";
		aud_dat_mosi_off = "/fragment@22/__overlay__/aud_dat_mosi_off";
		aud_dat_mosi_on = "/fragment@22/__overlay__/aud_dat_mosi_on";
		aud_pins_extamp_high = "/fragment@22/__overlay__/aud_pins_extamp_high";
		aud_pins_extamp_low = "/fragment@22/__overlay__/aud_pins_extamp_low";
		aud_pins_smartpa_off = "/fragment@22/__overlay__/aud_pins_smartpa_off";
		aud_pins_smartpa_on = "/fragment@22/__overlay__/aud_pins_smartpa_on";
		bpibus_ctrl_bpibus0_pin_high = "/fragment@30/__overlay__/bpibus0_pin_high";
		bpibus_ctrl_bpibus0_pin_low = "/fragment@30/__overlay__/bpibus0_pin_low";
		bpibus_ctrl_bpibus10_pin_high = "/fragment@30/__overlay__/bpibus10_pin_high";
		bpibus_ctrl_bpibus10_pin_low = "/fragment@30/__overlay__/bpibus10_pin_low";
		bpibus_ctrl_bpibus11_pin_high = "/fragment@30/__overlay__/bpibus11_pin_high";
		bpibus_ctrl_bpibus11_pin_low = "/fragment@30/__overlay__/bpibus11_pin_low";
		bpibus_ctrl_bpibus12_pin_high = "/fragment@30/__overlay__/bpibus12_pin_high";
		bpibus_ctrl_bpibus12_pin_low = "/fragment@30/__overlay__/bpibus12_pin_low";
		bpibus_ctrl_bpibus13_pin_high = "/fragment@30/__overlay__/bpibus13_pin_high";
		bpibus_ctrl_bpibus13_pin_low = "/fragment@30/__overlay__/bpibus13_pin_low";
		bpibus_ctrl_bpibus14_pin_high = "/fragment@30/__overlay__/bpibus14_pin_high";
		bpibus_ctrl_bpibus14_pin_low = "/fragment@30/__overlay__/bpibus14_pin_low";
		bpibus_ctrl_bpibus15_pin_high = "/fragment@30/__overlay__/bpibus15_pin_high";
		bpibus_ctrl_bpibus15_pin_low = "/fragment@30/__overlay__/bpibus15_pin_low";
		bpibus_ctrl_bpibus16_pin_high = "/fragment@30/__overlay__/bpibus16_pin_high";
		bpibus_ctrl_bpibus16_pin_low = "/fragment@30/__overlay__/bpibus16_pin_low";
		bpibus_ctrl_bpibus17_pin_high = "/fragment@30/__overlay__/bpibus17_pin_high";
		bpibus_ctrl_bpibus17_pin_low = "/fragment@30/__overlay__/bpibus17_pin_low";
		bpibus_ctrl_bpibus1_pin_high = "/fragment@30/__overlay__/bpibus1_pin_high";
		bpibus_ctrl_bpibus1_pin_low = "/fragment@30/__overlay__/bpibus1_pin_low";
		bpibus_ctrl_bpibus2_pin_high = "/fragment@30/__overlay__/bpibus2_pin_high";
		bpibus_ctrl_bpibus2_pin_low = "/fragment@30/__overlay__/bpibus2_pin_low";
		bpibus_ctrl_bpibus3_pin_high = "/fragment@30/__overlay__/bpibus3_pin_high";
		bpibus_ctrl_bpibus3_pin_low = "/fragment@30/__overlay__/bpibus3_pin_low";
		bpibus_ctrl_bpibus4_pin_high = "/fragment@30/__overlay__/bpibus4_pin_high";
		bpibus_ctrl_bpibus4_pin_low = "/fragment@30/__overlay__/bpibus4_pin_low";
		bpibus_ctrl_bpibus5_pin_high = "/fragment@30/__overlay__/bpibus5_pin_high";
		bpibus_ctrl_bpibus5_pin_low = "/fragment@30/__overlay__/bpibus5_pin_low";
		bpibus_ctrl_bpibus6_pin_high = "/fragment@30/__overlay__/bpibus6_pin_high";
		bpibus_ctrl_bpibus6_pin_low = "/fragment@30/__overlay__/bpibus6_pin_low";
		bpibus_ctrl_bpibus7_pin_high = "/fragment@30/__overlay__/bpibus7_pin_high";
		bpibus_ctrl_bpibus7_pin_low = "/fragment@30/__overlay__/bpibus7_pin_low";
		bpibus_ctrl_bpibus8_pin_high = "/fragment@30/__overlay__/bpibus8_pin_high";
		bpibus_ctrl_bpibus8_pin_low = "/fragment@30/__overlay__/bpibus8_pin_low";
		bpibus_ctrl_bpibus9_pin_high = "/fragment@30/__overlay__/bpibus9_pin_high";
		bpibus_ctrl_bpibus9_pin_low = "/fragment@30/__overlay__/bpibus9_pin_low";
		bpibus_ctrl_pin_default = "/fragment@30/__overlay__/bpibus_ctrl_defaultcfg";
		camera_main_af_mtk = "/fragment@36/__overlay__/camera_main_af@0c";
		camera_main_eeprom_mtk = "/fragment@36/__overlay__/camera_main_eeprom@50";
		camera_main_mtk = "/fragment@36/__overlay__/camera_main@1a";
		camera_main_two_mtk = "/fragment@39/__overlay__/camera_main_two@20";
		camera_pins_cam0_mclk_off = "/fragment@23/__overlay__/camera_pins_cam0_mclk_off";
		camera_pins_cam0_mclk_on = "/fragment@23/__overlay__/camera_pins_cam0_mclk_on";
		camera_pins_cam0_pnd0 = "/fragment@23/__overlay__/cam0@2";
		camera_pins_cam0_pnd1 = "/fragment@23/__overlay__/cam0@3";
		camera_pins_cam0_rst0 = "/fragment@23/__overlay__/cam0@0";
		camera_pins_cam0_rst1 = "/fragment@23/__overlay__/cam0@1";
		camera_pins_cam1_mclk_off = "/fragment@23/__overlay__/camera_pins_cam1_mclk_off";
		camera_pins_cam1_mclk_on = "/fragment@23/__overlay__/camera_pins_cam1_mclk_on";
		camera_pins_cam1_pnd0 = "/fragment@23/__overlay__/cam1@2";
		camera_pins_cam1_pnd1 = "/fragment@23/__overlay__/cam1@3";
		camera_pins_cam1_rst0 = "/fragment@23/__overlay__/cam1@0";
		camera_pins_cam1_rst1 = "/fragment@23/__overlay__/cam1@1";
		camera_pins_cam2_mclk_off = "/fragment@23/__overlay__/camera_pins_cam2_mclk_off";
		camera_pins_cam2_mclk_on = "/fragment@23/__overlay__/camera_pins_cam2_mclk_on";
		camera_pins_cam2_pnd0 = "/fragment@23/__overlay__/cam2@2";
		camera_pins_cam2_pnd1 = "/fragment@23/__overlay__/cam2@3";
		camera_pins_cam2_rst0 = "/fragment@23/__overlay__/cam2@0";
		camera_pins_cam2_rst1 = "/fragment@23/__overlay__/cam2@1";
		camera_pins_cam_ldo_rear2_vcama_0 = "/fragment@23/__overlay__/cam2@vcama0";
		camera_pins_cam_ldo_rear2_vcama_1 = "/fragment@23/__overlay__/cam2@vcama1";
		camera_pins_cam_ldo_rear_vcama_0 = "/fragment@23/__overlay__/cam0@vcama0";
		camera_pins_cam_ldo_rear_vcama_1 = "/fragment@23/__overlay__/cam0@vcama1";
		camera_pins_cam_ldo_rear_vcamd_0 = "/fragment@23/__overlay__/cam0@vcamd0";
		camera_pins_cam_ldo_rear_vcamd_1 = "/fragment@23/__overlay__/cam0@vcamd1";
		camera_pins_cam_ldo_sub_vcama_0 = "/fragment@23/__overlay__/cam1@vcama0";
		camera_pins_cam_ldo_sub_vcama_1 = "/fragment@23/__overlay__/cam1@vcama1";
		camera_pins_cam_ldo_sub_vcamd_0 = "/fragment@23/__overlay__/cam1@vcamd0";
		camera_pins_cam_ldo_sub_vcamd_1 = "/fragment@23/__overlay__/cam1@vcamd1";
		camera_pins_default = "/fragment@23/__overlay__/camdefault";
		camera_sub_eeprom_mtk = "/fragment@38/__overlay__/camera_sub_eeprom@52";
		camera_sub_mtk = "/fragment@38/__overlay__/camera_sub@2d";
		cap_touch_mtk = "/fragment@34/__overlay__/cap_touch@5d";
		consys_pins_default = "/fragment@12/__overlay__/consys_default";
		ctp_pins_default = "/fragment@11/__overlay__/eint0default";
		ctp_pins_eint_as_int = "/fragment@11/__overlay__/eint@0";
		ctp_pins_eint_output0 = "/fragment@11/__overlay__/eintoutput0";
		ctp_pins_eint_output1 = "/fragment@11/__overlay__/eintoutput1";
		ctp_pins_rst_output0 = "/fragment@11/__overlay__/rstoutput0";
		ctp_pins_rst_output1 = "/fragment@11/__overlay__/rstoutput1";
		finger_eint_as_int = "/fragment@1/__overlay__/finger_eint";
		finger_eint_in_float = "/fragment@1/__overlay__/finger_eint_float";
		finger_eint_in_low = "/fragment@1/__overlay__/finger_eint_low";
		finger_rst_mod_high = "/fragment@1/__overlay__/finger_rst_high";
		finger_rst_mod_low = "/fragment@1/__overlay__/finger_rst_low";
		flashlights_constant_gpio_main_enable_pin_high = "/fragment@19/__overlay__/main_enable_pin_high";
		flashlights_constant_gpio_main_enable_pin_low = "/fragment@19/__overlay__/main_enable_pin_low";
		flashlights_constant_gpio_main_strobe_pin_high = "/fragment@19/__overlay__/main_strobe_pin_high";
		flashlights_constant_gpio_main_strobe_pin_low = "/fragment@19/__overlay__/main_strobe_pin_low";
		flashlights_constant_gpio_pin_default = "/fragment@19/__overlay__/flashlight_defaultcfg";
		flashlights_constant_gpio_sub_enable_pin_high = "/fragment@19/__overlay__/sub_enable_pin_high";
		flashlights_constant_gpio_sub_enable_pin_low = "/fragment@19/__overlay__/sub_enable_pin_low";
		fpsensor_cs_mod_high = "/fragment@1/__overlay__/fpsensor_cs_high";
		fpsensor_cs_mode_low = "/fragment@1/__overlay__/fpsensor_cs_low";
		gpslna_pins_init = "/fragment@12/__overlay__/gpslna@0";
		gpslna_pins_oh = "/fragment@12/__overlay__/gpslna@1";
		gpslna_pins_ol = "/fragment@12/__overlay__/gpslna@2";
		gsensor_mtk = "/fragment@35/__overlay__/gsensor@4c";
		gyro_mtk = "/fragment@35/__overlay__/gyro@6b";
		i2c_lcd_bias_mtk = "/fragment@35/__overlay__/i2c_lcd_bias@7c";
		led0 = "/fragment@5/__overlay__/led@0";
		led1 = "/fragment@5/__overlay__/led@1";
		led2 = "/fragment@5/__overlay__/led@2";
		led3 = "/fragment@5/__overlay__/led@3";
		led4 = "/fragment@5/__overlay__/led@4";
		led5 = "/fragment@5/__overlay__/led@5";
		led6 = "/fragment@5/__overlay__/led@6";
		msensor_mtk = "/fragment@35/__overlay__/msensor@0c";
		mtkfb_pins_lcm_rst_out0_gpio = "/fragment@25/__overlay__/lcm_rst_out0_gpio";
		mtkfb_pins_lcm_rst_out1_gpio = "/fragment@25/__overlay__/lcm_rst_out1_gpio";
		nfc_mtk = "/fragment@37/__overlay__/nfc@08";
		spi_cs_mode_high = "/fragment@1/__overlay__/spi_cs_high";
		spi_cs_mode_low = "/fragment@1/__overlay__/spi_cs_low";
		spi_default = "/fragment@1/__overlay__/spi_default";
		spi_mclk_mode_high = "/fragment@1/__overlay__/spi_mclk_high";
		spi_mclk_mode_low = "/fragment@1/__overlay__/spi_mclk_low";
		spi_mi_mode_high = "/fragment@1/__overlay__/spi_mi_high";
		spi_mi_mode_low = "/fragment@1/__overlay__/spi_mi_low";
		spi_mo_mode_high = "/fragment@1/__overlay__/spi_mo_high";
		spi_mo_mode_low = "/fragment@1/__overlay__/spi_mo_low";
		vibrator0 = "/fragment@5/__overlay__/vibrator@0";
	};

	fragment@0 {
		target = <0xffffffff>;

		__overlay__ {
			debounce = <0x00>;
			interrupt-parent = <0xffffffff>;
			interrupts = <0x04 0x01 0x04 0x00>;
			status = "okay";
		};
	};

	fragment@1 {
		target = <0xffffffff>;

		__overlay__ {

			finger_eint {
				linux,phandle = <0x0c>;
				phandle = <0x0c>;

				pins_cmd_dat {
					bias-disable;
					pinmux = <0x400>;
					slew-rate = <0x00>;
				};
			};

			finger_eint_float {
				linux,phandle = <0x0e>;
				phandle = <0x0e>;

				pins_cmd_dat {
					bias-disable;
					pinmux = <0x400>;
					slew-rate = <0x00>;
				};
			};

			finger_eint_low {
				linux,phandle = <0x0d>;
				phandle = <0x0d>;

				pins_cmd_dat {
					bias-pull-down = <0x00>;
					pinmux = <0x400>;
					slew-rate = <0x00>;
				};
			};

			finger_rst_high {
				linux,phandle = <0x0b>;
				phandle = <0x0b>;

				pins_cmd_dat {
					bias-disable;
					output-high;
					pinmux = <0x500>;
					slew-rate = <0x01>;
				};
			};

			finger_rst_low {
				linux,phandle = <0x0a>;
				phandle = <0x0a>;

				pins_cmd_dat {
					bias-disable;
					output-low;
					pinmux = <0x500>;
					slew-rate = <0x01>;
				};
			};

			fpsensor_cs_high {
				linux,phandle = <0x10>;
				phandle = <0x10>;

				pins_cmd_dat {
					output-high;
					pinmux = <0x9c00>;
					slew-rate = <0x01>;
				};
			};

			fpsensor_cs_low {
				linux,phandle = <0x0f>;
				phandle = <0x0f>;

				pins_cmd_dat {
					output-low;
					pinmux = <0x9c00>;
					slew-rate = <0x01>;
				};
			};

			spi_cs_high {
				linux,phandle = <0x03>;
				phandle = <0x03>;

				pins_cmd_dat {
					bias-pull-up = <0x0b>;
					output-high;
					pinmux = <0x9c01>;
					slew-rate = <0x01>;
				};
			};

			spi_cs_low {
				linux,phandle = <0x02>;
				phandle = <0x02>;

				pins_cmd_dat {
					bias-pull-up = <0x0b>;
					output-low;
					pinmux = <0x9c01>;
					slew-rate = <0x01>;
				};
			};

			spi_default {
				linux,phandle = <0x01>;
				phandle = <0x01>;
			};

			spi_mclk_high {
				linux,phandle = <0x09>;
				phandle = <0x09>;

				pins_cmd_dat {
					bias-pull-up = <0x0b>;
					output-high;
					pinmux = <0x9e01>;
					slew-rate = <0x01>;
				};
			};

			spi_mclk_low {
				linux,phandle = <0x08>;
				phandle = <0x08>;

				pins_cmd_dat {
					bias-pull-up = <0x0b>;
					output-low;
					pinmux = <0x9e01>;
					slew-rate = <0x01>;
				};
			};

			spi_mi_high {
				linux,phandle = <0x05>;
				phandle = <0x05>;

				pins_cmd_dat {
					bias-pull-up = <0x0b>;
					output-high;
					pinmux = <0x9b01>;
					slew-rate = <0x00>;
				};
			};

			spi_mi_low {
				linux,phandle = <0x04>;
				phandle = <0x04>;

				pins_cmd_dat {
					bias-pull-up = <0x0b>;
					output-low;
					pinmux = <0x9b01>;
					slew-rate = <0x00>;
				};
			};

			spi_mo_high {
				linux,phandle = <0x07>;
				phandle = <0x07>;

				pins_cmd_dat {
					bias-pull-up = <0x0b>;
					output-high;
					pinmux = <0x9d01>;
					slew-rate = <0x01>;
				};
			};

			spi_mo_low {
				linux,phandle = <0x06>;
				phandle = <0x06>;

				pins_cmd_dat {
					bias-pull-up = <0x0b>;
					output-low;
					pinmux = <0x9d01>;
					slew-rate = <0x01>;
				};
			};
		};
	};

	fragment@10 {
		target = <0xffffffff>;

		__overlay__ {
			pinctrl-0 = <0x13>;
			pinctrl-1 = <0x14>;
			pinctrl-2 = <0x15>;
			pinctrl-3 = <0x16>;
			pinctrl-4 = <0x17>;
			pinctrl-5 = <0x18>;
			pinctrl-names = "default\0state_eint_as_int\0state_eint_output0\0state_eint_output1\0state_rst_output0\0state_rst_output1";
			status = "okay";
			touch,int-lead-gpio = <0xffffffff 0x00 0x00>;
			tpd-filter-custom-prameters = <0x00 0x00 0x00 0x00 0x00 0x00 0x00 0x00 0x00 0x00 0x00 0x00>;
			tpd-filter-custom-speed = <0x00 0x00 0x00>;
			tpd-filter-enable = <0x00>;
			tpd-filter-pixel-density = <0x92>;
			tpd-key-dim-local = <0x5a 0x373 0x64 0x28 0xe6 0x373 0x64 0x28 0x172 0x373 0x64 0x28 0x00 0x00 0x00 0x00>;
			tpd-key-local = <0x8b 0xac 0x9e 0x00>;
			tpd-key-num = <0x03>;
			tpd-max-touch-num = <0x05>;
			tpd-resolution = <0x438 0x780>;
			use-tpd-button = <0x01>;
		};
	};

	fragment@11 {
		target = <0xffffffff>;

		__overlay__ {

			eint0default {
				linux,phandle = <0x13>;
				phandle = <0x13>;
			};

			eint@0 {
				linux,phandle = <0x14>;
				phandle = <0x14>;

				pins_cmd_dat {
					bias-disable;
					pinmux = <0x00>;
					slew-rate = <0x00>;
				};
			};

			eintoutput0 {
				linux,phandle = <0x15>;
				phandle = <0x15>;

				pins_cmd_dat {
					output-low;
					pinmux = <0x00>;
					slew-rate = <0x01>;
				};
			};

			eintoutput1 {
				linux,phandle = <0x16>;
				phandle = <0x16>;

				pins_cmd_dat {
					output-high;
					pinmux = <0x00>;
					slew-rate = <0x01>;
				};
			};

			rstoutput0 {
				linux,phandle = <0x17>;
				phandle = <0x17>;

				pins_cmd_dat {
					output-low;
					pinmux = <0xae00>;
					slew-rate = <0x01>;
				};
			};

			rstoutput1 {
				linux,phandle = <0x18>;
				phandle = <0x18>;

				pins_cmd_dat {
					output-high;
					pinmux = <0xae00>;
					slew-rate = <0x01>;
				};
			};
		};
	};

	fragment@12 {
		target = <0xffffffff>;

		__overlay__ {

			consys_default {
				linux,phandle = <0x19>;
				phandle = <0x19>;
			};

			gpslna@0 {
				linux,phandle = <0x1a>;
				phandle = <0x1a>;

				pins_cmd_dat {
					bias-disable;
					output-low;
					pinmux = <0x800>;
					slew-rate = <0x00>;
				};
			};

			gpslna@1 {
				linux,phandle = <0x1b>;
				phandle = <0x1b>;

				pins_cmd_dat {
					output-high;
					pinmux = <0x800>;
					slew-rate = <0x01>;
				};
			};

			gpslna@2 {
				linux,phandle = <0x1c>;
				phandle = <0x1c>;

				pins_cmd_dat {
					output-low;
					pinmux = <0x800>;
					slew-rate = <0x01>;
				};
			};
		};
	};

	fragment@13 {
		target = <0xffffffff>;

		__overlay__ {
			pinctrl-0 = <0x19>;
			pinctrl-1 = <0x1a>;
			pinctrl-2 = <0x1b>;
			pinctrl-3 = <0x1c>;
			pinctrl-names = "default\0gps_lna_state_init\0gps_lna_state_oh\0gps_lna_state_ol";
			status = "okay";
		};
	};

	fragment@14 {
		target = <0xffffffff>;

		__overlay__ {

			alsps@49 {
				compatible = "mediatek,alsps_epl259x";
				reg = <0x49>;
				status = "okay";
			};
		};
	};

	fragment@15 {
		target = <0xffffffff>;

		__overlay__ {

			alsps@48 {
				compatible = "mediatek,alsps_stk3x1x";
				reg = <0x48>;
				status = "okay";
			};
		};
	};

	fragment@16 {
		target = <0xffffffff>;

		__overlay__ {

			alspsdefaultcfg {
				linux,phandle = <0x11>;
				phandle = <0x11>;
			};

			alspspincfg {
				linux,phandle = <0x12>;
				phandle = <0x12>;

				pins_cmd_dat {
					bias-pull-up = <0x65>;
					pinmux = <0x600>;
					slew-rate = <0x00>;
				};
			};
		};
	};

	fragment@17 {
		target = <0xffffffff>;

		__overlay__ {
			accdet-mic-mode = <0x01>;
			accdet-mic-vol = <0x07>;
			accdet-plugout-debounce = <0x01>;
			headset-eint-level-pol = <0x08>;
			headset-four-key-threshold = <0x00 0x3a 0x79 0xc0 0x190>;
			headset-mode-setting = <0x500 0x500 0x01 0x1f0 0x800 0x800 0x20 0x44>;
			headset-three-key-threshold = <0x00 0x50 0xdc 0x190>;
			headset-three-key-threshold-CDD = <0x00 0x79 0xc0 0x258>;
			pinctrl-0 = <0x1d>;
			pinctrl-1 = <0x1e>;
			pinctrl-names = "default\0state_eint_as_int";
			status = "okay";
		};
	};

	fragment@18 {
		target = <0xffffffff>;

		__overlay__ {

			accdetdefault {
				linux,phandle = <0x1d>;
				phandle = <0x1d>;
			};

			accdeteint@0 {
				linux,phandle = <0x1e>;
				phandle = <0x1e>;
			};
		};
	};

	fragment@19 {
		target = <0xffffffff>;

		__overlay__ {

			flashlight_defaultcfg {
				linux,phandle = <0x1f>;
				phandle = <0x1f>;
			};

			main_enable_pin_high {
				linux,phandle = <0x20>;
				phandle = <0x20>;

				pins_cmd_dat {
					bias-disable;
					output-high;
					pinmux = <0xab00>;
					slew-rate = <0x01>;
				};
			};

			main_enable_pin_low {
				linux,phandle = <0x21>;
				phandle = <0x21>;

				pins_cmd_dat {
					bias-disable;
					output-low;
					pinmux = <0xab00>;
					slew-rate = <0x01>;
				};
			};

			main_strobe_pin_high {
				linux,phandle = <0x22>;
				phandle = <0x22>;

				pins_cmd_dat {
					bias-disable;
					output-high;
					pinmux = <0xad00>;
					slew-rate = <0x01>;
				};
			};

			main_strobe_pin_low {
				linux,phandle = <0x23>;
				phandle = <0x23>;

				pins_cmd_dat {
					bias-disable;
					output-low;
					pinmux = <0xad00>;
					slew-rate = <0x01>;
				};
			};

			sub_enable_pin_high {
				linux,phandle = <0x24>;
				phandle = <0x24>;
			};

			sub_enable_pin_low {
				linux,phandle = <0x25>;
				phandle = <0x25>;
			};
		};
	};

	fragment@2 {
		target = <0xffffffff>;

		__overlay__ {
			pinctrl-0 = <0x01>;
			pinctrl-1 = <0x02>;
			pinctrl-10 = <0x0b>;
			pinctrl-11 = <0x0c>;
			pinctrl-12 = <0x0d>;
			pinctrl-13 = <0x0e>;
			pinctrl-14 = <0x0f>;
			pinctrl-15 = <0x10>;
			pinctrl-2 = <0x03>;
			pinctrl-3 = <0x04>;
			pinctrl-4 = <0x05>;
			pinctrl-5 = <0x06>;
			pinctrl-6 = <0x07>;
			pinctrl-7 = <0x08>;
			pinctrl-8 = <0x09>;
			pinctrl-9 = <0x0a>;
			pinctrl-names = "spi_default\0spi_cs_low\0spi_cs_high\0spi_mi_low\0spi_mi_high\0spi_mo_low\0spi_mo_high\0spi_mclk_low\0spi_mclk_high\0finger_rst_low\0finger_rst_high\0finger_eint\0finger_eint_low\0finger_eint_float\0fpsensor_cs_low\0fpsensor_cs_high";
			status = "okay";
		};
	};

	fragment@20 {
		target = <0xffffffff>;

		__overlay__ {
			pinctrl-0 = <0x1f>;
			pinctrl-1 = <0x20>;
			pinctrl-2 = <0x21>;
			pinctrl-3 = <0x22>;
			pinctrl-4 = <0x23>;
			pinctrl-5 = <0x24>;
			pinctrl-6 = <0x25>;
			pinctrl-names = "pin_default\0main_enable_pin_high\0main_enable_pin_low\0main_strobe_pin_high\0main_strobe_pin_low\0sub_enable_pin_high\0sub_enable_pin_low";
			status = "okay";
		};
	};

	fragment@21 {
		target = <0xffffffff>;

		__overlay__ {
			pinctrl-0 = <0x26>;
			pinctrl-1 = <0x27>;
			pinctrl-10 = <0x30>;
			pinctrl-11 = <0x31>;
			pinctrl-2 = <0x28>;
			pinctrl-3 = <0x29>;
			pinctrl-4 = <0x2a>;
			pinctrl-5 = <0x2b>;
			pinctrl-6 = <0x2c>;
			pinctrl-7 = <0x2d>;
			pinctrl-8 = <0x2e>;
			pinctrl-9 = <0x2f>;
			pinctrl-names = "aud_clk_mosi_off\0aud_clk_mosi_on\0aud_clk_miso_off\0aud_clk_miso_on\0aud_dat_mosi_off\0aud_dat_mosi_on\0aud_dat_miso_off\0aud_dat_miso_on\0aud_smartpa_off\0aud_smartpa_on\0extamp-pullhigh\0extamp-pulllow";
			status = "okay";
		};
	};

	fragment@22 {
		target = <0xffffffff>;

		__overlay__ {

			aud_clk_miso_off {
				linux,phandle = <0x28>;
				phandle = <0x28>;

				pins_cmd0_dat {
					pinmux = <0x8c00>;
				};
			};

			aud_clk_miso_on {
				linux,phandle = <0x29>;
				phandle = <0x29>;

				pins_cmd0_dat {
					pinmux = <0x8c01>;
				};
			};

			aud_clk_mosi_off {
				linux,phandle = <0x26>;
				phandle = <0x26>;

				pins_cmd0_dat {
					pinmux = <0x8800>;
				};
			};

			aud_clk_mosi_on {
				linux,phandle = <0x27>;
				phandle = <0x27>;

				pins_cmd0_dat {
					pinmux = <0x8801>;
				};
			};

			aud_dat_miso_off {
				linux,phandle = <0x2c>;
				phandle = <0x2c>;

				pins_cmd1_dat {
					bias-disable;
					input-enable;
					pinmux = <0x8e00>;
					slew-rate = <0x00>;
				};

				pins_cmd2_dat {
					bias-disable;
					input-enable;
					pinmux = <0x8f00>;
					slew-rate = <0x00>;
				};
			};

			aud_dat_miso_on {
				linux,phandle = <0x2d>;
				phandle = <0x2d>;

				pins_cmd1_dat {
					pinmux = <0x8e01>;
				};

				pins_cmd2_dat {
					pinmux = <0x8f01>;
				};
			};

			aud_dat_mosi_off {
				linux,phandle = <0x2a>;
				phandle = <0x2a>;

				pins_cmd1_dat {
					bias-disable;
					input-enable;
					pinmux = <0x8a00>;
					slew-rate = <0x00>;
				};

				pins_cmd2_dat {
					bias-disable;
					input-enable;
					pinmux = <0x8b00>;
					slew-rate = <0x00>;
				};
			};

			aud_dat_mosi_on {
				linux,phandle = <0x2b>;
				phandle = <0x2b>;

				pins_cmd1_dat {
					pinmux = <0x8a01>;
				};

				pins_cmd2_dat {
					pinmux = <0x8b01>;
				};
			};

			aud_pins_extamp_high {
				linux,phandle = <0x30>;
				phandle = <0x30>;

				pins_cmd_dat {
					output-high;
					pinmux = <0x9f00>;
					slew-rate = <0x01>;
				};
			};

			aud_pins_extamp_low {
				linux,phandle = <0x31>;
				phandle = <0x31>;

				pins_cmd_dat {
					output-low;
					pinmux = <0x9f00>;
					slew-rate = <0x01>;
				};
			};

			aud_pins_smartpa_off {
				linux,phandle = <0x2e>;
				phandle = <0x2e>;

				pins_cmd0_dat {
					pinmux = <0x1100>;
				};

				pins_cmd1_dat {
					pinmux = <0x1200>;
				};

				pins_cmd2_dat {
					pinmux = <0x1300>;
				};

				pins_cmd3_dat {
					pinmux = <0x1400>;
				};
			};

			aud_pins_smartpa_on {
				linux,phandle = <0x2f>;
				phandle = <0x2f>;

				pins_cmd0_dat {
					pinmux = <0x1106>;
				};

				pins_cmd1_dat {
					pinmux = <0x1206>;
				};

				pins_cmd2_dat {
					pinmux = <0x1306>;
				};

				pins_cmd3_dat {
					pinmux = <0x1406>;
				};
			};
		};
	};

	fragment@23 {
		target = <0xffffffff>;

		__overlay__ {

			cam0@0 {
				linux,phandle = <0x33>;
				phandle = <0x33>;

				pins_cmd_dat {
					output-low;
					pinmux = <0x6500>;
					slew-rate = <0x01>;
				};
			};

			cam0@1 {
				linux,phandle = <0x34>;
				phandle = <0x34>;

				pins_cmd_dat {
					output-high;
					pinmux = <0x6500>;
					slew-rate = <0x01>;
				};
			};

			cam0@2 {
				linux,phandle = <0x35>;
				phandle = <0x35>;

				pins_cmd_dat {
					output-low;
					pinmux = <0x6100>;
					slew-rate = <0x01>;
				};
			};

			cam0@3 {
				linux,phandle = <0x36>;
				phandle = <0x36>;

				pins_cmd_dat {
					output-high;
					pinmux = <0x6100>;
					slew-rate = <0x01>;
				};
			};

			cam0@vcama0 {
				linux,phandle = <0x4e>;
				phandle = <0x4e>;

				pins_cmd_dat {
					output-low;
					pinmux = <0xc00>;
					slew-rate = <0x01>;
				};
			};

			cam0@vcama1 {
				linux,phandle = <0x4d>;
				phandle = <0x4d>;

				pins_cmd_dat {
					output-high;
					pinmux = <0xc00>;
					slew-rate = <0x01>;
				};
			};

			cam0@vcamd0 {
				linux,phandle = <0x40>;
				phandle = <0x40>;
			};

			cam0@vcamd1 {
				linux,phandle = <0x3f>;
				phandle = <0x3f>;
			};

			cam1@0 {
				linux,phandle = <0x37>;
				phandle = <0x37>;

				pins_cmd_dat {
					output-low;
					pinmux = <0x6600>;
					slew-rate = <0x01>;
				};
			};

			cam1@1 {
				linux,phandle = <0x38>;
				phandle = <0x38>;

				pins_cmd_dat {
					output-high;
					pinmux = <0x6600>;
					slew-rate = <0x01>;
				};
			};

			cam1@2 {
				linux,phandle = <0x39>;
				phandle = <0x39>;

				pins_cmd_dat {
					output-low;
					pinmux = <0x6200>;
					slew-rate = <0x01>;
				};
			};

			cam1@3 {
				linux,phandle = <0x3a>;
				phandle = <0x3a>;

				pins_cmd_dat {
					output-high;
					pinmux = <0x6200>;
					slew-rate = <0x01>;
				};
			};

			cam1@vcama0 {
				linux,phandle = <0x44>;
				phandle = <0x44>;

				pins_cmd_dat {
					output-low;
					pinmux = <0xc00>;
					slew-rate = <0x01>;
				};
			};

			cam1@vcama1 {
				linux,phandle = <0x43>;
				phandle = <0x43>;

				pins_cmd_dat {
					output-high;
					pinmux = <0xc00>;
					slew-rate = <0x01>;
				};
			};

			cam1@vcamd0 {
				linux,phandle = <0x42>;
				phandle = <0x42>;
			};

			cam1@vcamd1 {
				linux,phandle = <0x41>;
				phandle = <0x41>;
			};

			cam2@0 {
				linux,phandle = <0x3b>;
				phandle = <0x3b>;

				pins_cmd_dat {
					output-low;
					pinmux = <0x6d00>;
					slew-rate = <0x01>;
				};
			};

			cam2@1 {
				linux,phandle = <0x3c>;
				phandle = <0x3c>;

				pins_cmd_dat {
					output-high;
					pinmux = <0x6d00>;
					slew-rate = <0x01>;
				};
			};

			cam2@2 {
				linux,phandle = <0x3d>;
				phandle = <0x3d>;

				pins_cmd_dat {
					output-low;
					pinmux = <0x6b00>;
					slew-rate = <0x01>;
				};
			};

			cam2@3 {
				linux,phandle = <0x3e>;
				phandle = <0x3e>;

				pins_cmd_dat {
					output-high;
					pinmux = <0x6b00>;
					slew-rate = <0x01>;
				};
			};

			cam2@vcama0 {
				linux,phandle = <0x46>;
				phandle = <0x46>;
			};

			cam2@vcama1 {
				linux,phandle = <0x45>;
				phandle = <0x45>;
			};

			camdefault {
				linux,phandle = <0x32>;
				phandle = <0x32>;
			};

			camera_pins_cam0_mclk_off {
				linux,phandle = <0x48>;
				phandle = <0x48>;

				pins_cmd_dat {
					pinmux = <0x6300>;
				};
			};

			camera_pins_cam0_mclk_on {
				linux,phandle = <0x47>;
				phandle = <0x47>;

				pins_cmd_dat {
					pinmux = <0x6301>;
				};
			};

			camera_pins_cam1_mclk_off {
				linux,phandle = <0x4a>;
				phandle = <0x4a>;

				pins_cmd_dat {
					pinmux = <0x6400>;
				};
			};

			camera_pins_cam1_mclk_on {
				linux,phandle = <0x49>;
				phandle = <0x49>;

				pins_cmd_dat {
					pinmux = <0x6401>;
				};
			};

			camera_pins_cam2_mclk_off {
				linux,phandle = <0x4c>;
				phandle = <0x4c>;

				pins_cmd_dat {
					pinmux = <0x6c00>;
				};
			};

			camera_pins_cam2_mclk_on {
				linux,phandle = <0x4b>;
				phandle = <0x4b>;

				pins_cmd_dat {
					pinmux = <0x6c01>;
				};
			};
		};
	};

	fragment@24 {
		target = <0xffffffff>;

		__overlay__ {
			cam0_vcamd-supply = <0xffffffff>;
			cam0_vcamio-supply = <0xffffffff>;
			cam1_vcamd-supply = <0xffffffff>;
			cam1_vcamio-supply = <0xffffffff>;
			cam2_vcama-supply = <0xffffffff>;
			cam2_vcamd-supply = <0xffffffff>;
			cam2_vcamio-supply = <0xffffffff>;
			pinctrl-0 = <0x32>;
			pinctrl-1 = <0x33>;
			pinctrl-10 = <0x3c>;
			pinctrl-11 = <0x3d>;
			pinctrl-12 = <0x3e>;
			pinctrl-13 = <0x3f>;
			pinctrl-14 = <0x40>;
			pinctrl-15 = <0x41>;
			pinctrl-16 = <0x42>;
			pinctrl-17 = <0x43>;
			pinctrl-18 = <0x44>;
			pinctrl-19 = <0x45>;
			pinctrl-2 = <0x34>;
			pinctrl-20 = <0x46>;
			pinctrl-21 = <0x47>;
			pinctrl-22 = <0x48>;
			pinctrl-23 = <0x49>;
			pinctrl-24 = <0x4a>;
			pinctrl-25 = <0x4b>;
			pinctrl-26 = <0x4c>;
			pinctrl-27 = <0x4d>;
			pinctrl-28 = <0x4e>;
			pinctrl-3 = <0x35>;
			pinctrl-4 = <0x36>;
			pinctrl-5 = <0x37>;
			pinctrl-6 = <0x38>;
			pinctrl-7 = <0x39>;
			pinctrl-8 = <0x3a>;
			pinctrl-9 = <0x3b>;
			pinctrl-names = "default\0cam0_rst0\0cam0_rst1\0cam0_pnd0\0cam0_pnd1\0cam1_rst0\0cam1_rst1\0cam1_pnd0\0cam1_pnd1\0cam2_rst0\0cam2_rst1\0cam2_pnd0\0cam2_pnd1\0cam0_vcamd_on\0cam0_vcamd_off\0cam1_vcamd_on\0cam1_vcamd_off\0cam1_vcama_on\0cam1_vcama_off\0cam2_vcama_on\0cam2_vcama_off\0cam0_mclk_on\0cam0_mclk_off\0cam1_mclk_on\0cam1_mclk_off\0cam2_mclk_on\0cam2_mclk_off\0cam0_vcama_on\0cam0_vcama_off";
			status = "okay";
		};
	};

	fragment@25 {
		target = <0xffffffff>;

		__overlay__ {

			lcm_rst_out0_gpio {
				linux,phandle = <0x50>;
				phandle = <0x50>;

				pins_cmd_dat {
					output-low;
					pinmux = <0x2d00>;
					slew-rate = <0x01>;
				};
			};

			lcm_rst_out1_gpio {
				linux,phandle = <0x4f>;
				phandle = <0x4f>;

				pins_cmd_dat {
					output-high;
					pinmux = <0x2d00>;
					slew-rate = <0x01>;
				};
			};
		};
	};

	fragment@26 {
		target = <0xffffffff>;

		__overlay__ {
			pinctrl-0 = <0x4f>;
			pinctrl-1 = <0x50>;
			pinctrl-names = "lcm_rst_out1_gpio\0lcm_rst_out0_gpio";
			status = "okay";
		};
	};

	fragment@27 {
		target = <0xffffffff>;

		__overlay__ {
			gpio-irq = <0x01>;
			gpio-irq-std = <0xffffffff 0x01 0x00>;
			gpio-rst = <0xac>;
			gpio-rst-std = <0xffffffff 0xac 0x00>;
		};
	};

	fragment@28 {
		target = <0xffffffff>;

		__overlay__ {
			gpio_charge_en = <0xffffffff 0x4c 0x00>;
			gpio_lcd_id = <0xffffffff 0x03 0x00>;
			gpio_lcm_enn = <0xffffffff 0x99 0x00>;
			gpio_lcm_enp = <0xffffffff 0x96 0x00>;
			gpio_otg_en = <0xffffffff 0x07 0x00>;
			gpio_wifi_en = <0xffffffff 0xb2 0x00>;
		};
	};

	fragment@29 {
		target = <0xffffffff>;

		__overlay__ {
			cd-gpios = <0xffffffff 0x09 0x00>;
		};
	};

	fragment@3 {
		target = <0xffffffff>;

		__overlay__ {
			#address-cells = <0x01>;
			#size-cells = <0x00>;
			status = "okay";

			icn7152l_finger {
				compatible = "mediatek,icn7152l_finger";
				reg = <0x00>;
				spi-max-frequency = <0x7a1200>;
				status = "okay";
			};
		};
	};

	fragment@30 {
		target = <0xffffffff>;

		__overlay__ {

			bpibus0_pin_high {
				linux,phandle = <0x52>;
				phandle = <0x52>;

				pins_cmd_dat {
					bias-disable;
					output-high;
					pinmux = <0x4c00>;
					slew-rate = <0x01>;
				};
			};

			bpibus0_pin_low {
				linux,phandle = <0x53>;
				phandle = <0x53>;

				pins_cmd_dat {
					bias-disable;
					output-low;
					pinmux = <0x4c00>;
					slew-rate = <0x01>;
				};
			};

			bpibus10_pin_high {
				linux,phandle = <0x66>;
				phandle = <0x66>;

				pins_cmd_dat {
					bias-disable;
					output-high;
					pinmux = <0x3900>;
					slew-rate = <0x01>;
				};
			};

			bpibus10_pin_low {
				linux,phandle = <0x67>;
				phandle = <0x67>;

				pins_cmd_dat {
					bias-disable;
					output-low;
					pinmux = <0x3900>;
					slew-rate = <0x01>;
				};
			};

			bpibus11_pin_high {
				linux,phandle = <0x68>;
				phandle = <0x68>;

				pins_cmd_dat {
					bias-disable;
					output-high;
					pinmux = <0x4e00>;
					slew-rate = <0x01>;
				};
			};

			bpibus11_pin_low {
				linux,phandle = <0x69>;
				phandle = <0x69>;

				pins_cmd_dat {
					bias-disable;
					output-low;
					pinmux = <0x4e00>;
					slew-rate = <0x01>;
				};
			};

			bpibus12_pin_high {
				linux,phandle = <0x6a>;
				phandle = <0x6a>;

				pins_cmd_dat {
					bias-disable;
					output-high;
					pinmux = <0x3600>;
					slew-rate = <0x01>;
				};
			};

			bpibus12_pin_low {
				linux,phandle = <0x6b>;
				phandle = <0x6b>;

				pins_cmd_dat {
					bias-disable;
					output-low;
					pinmux = <0x3600>;
					slew-rate = <0x01>;
				};
			};

			bpibus13_pin_high {
				linux,phandle = <0x6c>;
				phandle = <0x6c>;

				pins_cmd_dat {
					bias-disable;
					output-high;
					pinmux = <0x3500>;
					slew-rate = <0x01>;
				};
			};

			bpibus13_pin_low {
				linux,phandle = <0x6d>;
				phandle = <0x6d>;

				pins_cmd_dat {
					bias-disable;
					output-low;
					pinmux = <0x3500>;
					slew-rate = <0x01>;
				};
			};

			bpibus14_pin_high {
				linux,phandle = <0x6e>;
				phandle = <0x6e>;

				pins_cmd_dat {
					bias-disable;
					output-high;
					pinmux = <0x4d00>;
					slew-rate = <0x01>;
				};
			};

			bpibus14_pin_low {
				linux,phandle = <0x6f>;
				phandle = <0x6f>;

				pins_cmd_dat {
					bias-disable;
					output-low;
					pinmux = <0x4d00>;
					slew-rate = <0x01>;
				};
			};

			bpibus15_pin_high {
				linux,phandle = <0x70>;
				phandle = <0x70>;

				pins_cmd_dat {
					bias-disable;
					output-high;
					pinmux = <0x3400>;
					slew-rate = <0x01>;
				};
			};

			bpibus15_pin_low {
				linux,phandle = <0x71>;
				phandle = <0x71>;

				pins_cmd_dat {
					bias-disable;
					output-low;
					pinmux = <0x3400>;
					slew-rate = <0x01>;
				};
			};

			bpibus16_pin_high {
				linux,phandle = <0x72>;
				phandle = <0x72>;

				pins_cmd_dat {
					bias-disable;
					output-high;
					pinmux = <0x4100>;
					slew-rate = <0x01>;
				};
			};

			bpibus16_pin_low {
				linux,phandle = <0x73>;
				phandle = <0x73>;

				pins_cmd_dat {
					bias-disable;
					output-low;
					pinmux = <0x4100>;
					slew-rate = <0x01>;
				};
			};

			bpibus17_pin_high {
				linux,phandle = <0x74>;
				phandle = <0x74>;

				pins_cmd_dat {
					bias-disable;
					output-high;
					pinmux = <0x4200>;
					slew-rate = <0x01>;
				};
			};

			bpibus17_pin_low {
				linux,phandle = <0x75>;
				phandle = <0x75>;

				pins_cmd_dat {
					bias-disable;
					output-low;
					pinmux = <0x4200>;
					slew-rate = <0x01>;
				};
			};

			bpibus1_pin_high {
				linux,phandle = <0x54>;
				phandle = <0x54>;

				pins_cmd_dat {
					bias-disable;
					output-high;
					pinmux = <0x4b00>;
					slew-rate = <0x01>;
				};
			};

			bpibus1_pin_low {
				linux,phandle = <0x55>;
				phandle = <0x55>;

				pins_cmd_dat {
					bias-disable;
					output-low;
					pinmux = <0x4b00>;
					slew-rate = <0x01>;
				};
			};

			bpibus2_pin_high {
				linux,phandle = <0x56>;
				phandle = <0x56>;

				pins_cmd_dat {
					bias-disable;
					output-high;
					pinmux = <0x4a00>;
					slew-rate = <0x01>;
				};
			};

			bpibus2_pin_low {
				linux,phandle = <0x57>;
				phandle = <0x57>;

				pins_cmd_dat {
					bias-disable;
					output-low;
					pinmux = <0x4a00>;
					slew-rate = <0x01>;
				};
			};

			bpibus3_pin_high {
				linux,phandle = <0x58>;
				phandle = <0x58>;

				pins_cmd_dat {
					bias-disable;
					output-high;
					pinmux = <0x4900>;
					slew-rate = <0x01>;
				};
			};

			bpibus3_pin_low {
				linux,phandle = <0x59>;
				phandle = <0x59>;

				pins_cmd_dat {
					bias-disable;
					output-low;
					pinmux = <0x4900>;
					slew-rate = <0x01>;
				};
			};

			bpibus4_pin_high {
				linux,phandle = <0x5a>;
				phandle = <0x5a>;

				pins_cmd_dat {
					bias-disable;
					output-high;
					pinmux = <0x4800>;
					slew-rate = <0x01>;
				};
			};

			bpibus4_pin_low {
				linux,phandle = <0x5b>;
				phandle = <0x5b>;

				pins_cmd_dat {
					bias-disable;
					output-low;
					pinmux = <0x4800>;
					slew-rate = <0x01>;
				};
			};

			bpibus5_pin_high {
				linux,phandle = <0x5c>;
				phandle = <0x5c>;

				pins_cmd_dat {
					bias-disable;
					output-high;
					pinmux = <0x4700>;
					slew-rate = <0x01>;
				};
			};

			bpibus5_pin_low {
				linux,phandle = <0x5d>;
				phandle = <0x5d>;

				pins_cmd_dat {
					bias-disable;
					output-low;
					pinmux = <0x4700>;
					slew-rate = <0x01>;
				};
			};

			bpibus6_pin_high {
				linux,phandle = <0x5e>;
				phandle = <0x5e>;

				pins_cmd_dat {
					bias-disable;
					output-high;
					pinmux = <0x4600>;
					slew-rate = <0x01>;
				};
			};

			bpibus6_pin_low {
				linux,phandle = <0x5f>;
				phandle = <0x5f>;

				pins_cmd_dat {
					bias-disable;
					output-low;
					pinmux = <0x4600>;
					slew-rate = <0x01>;
				};
			};

			bpibus7_pin_high {
				linux,phandle = <0x60>;
				phandle = <0x60>;

				pins_cmd_dat {
					bias-disable;
					output-high;
					pinmux = <0x4500>;
					slew-rate = <0x01>;
				};
			};

			bpibus7_pin_low {
				linux,phandle = <0x61>;
				phandle = <0x61>;

				pins_cmd_dat {
					bias-disable;
					output-low;
					pinmux = <0x4500>;
					slew-rate = <0x01>;
				};
			};

			bpibus8_pin_high {
				linux,phandle = <0x62>;
				phandle = <0x62>;

				pins_cmd_dat {
					bias-disable;
					output-high;
					pinmux = <0x3700>;
					slew-rate = <0x01>;
				};
			};

			bpibus8_pin_low {
				linux,phandle = <0x63>;
				phandle = <0x63>;

				pins_cmd_dat {
					bias-disable;
					output-low;
					pinmux = <0x3700>;
					slew-rate = <0x01>;
				};
			};

			bpibus9_pin_high {
				linux,phandle = <0x64>;
				phandle = <0x64>;

				pins_cmd_dat {
					bias-disable;
					output-high;
					pinmux = <0x3800>;
					slew-rate = <0x01>;
				};
			};

			bpibus9_pin_low {
				linux,phandle = <0x65>;
				phandle = <0x65>;

				pins_cmd_dat {
					bias-disable;
					output-low;
					pinmux = <0x3800>;
					slew-rate = <0x01>;
				};
			};

			bpibus_ctrl_defaultcfg {
				linux,phandle = <0x51>;
				phandle = <0x51>;
			};
		};
	};

	fragment@31 {
		target = <0xffffffff>;

		__overlay__ {
			pinctrl-0 = <0x51>;
			pinctrl-1 = <0x52>;
			pinctrl-10 = <0x5b>;
			pinctrl-11 = <0x5c>;
			pinctrl-12 = <0x5d>;
			pinctrl-13 = <0x5e>;
			pinctrl-14 = <0x5f>;
			pinctrl-15 = <0x60>;
			pinctrl-16 = <0x61>;
			pinctrl-17 = <0x62>;
			pinctrl-18 = <0x63>;
			pinctrl-19 = <0x64>;
			pinctrl-2 = <0x53>;
			pinctrl-20 = <0x65>;
			pinctrl-21 = <0x66>;
			pinctrl-22 = <0x67>;
			pinctrl-23 = <0x68>;
			pinctrl-24 = <0x69>;
			pinctrl-25 = <0x6a>;
			pinctrl-26 = <0x6b>;
			pinctrl-27 = <0x6c>;
			pinctrl-28 = <0x6d>;
			pinctrl-29 = <0x6e>;
			pinctrl-3 = <0x54>;
			pinctrl-30 = <0x6f>;
			pinctrl-31 = <0x70>;
			pinctrl-32 = <0x71>;
			pinctrl-33 = <0x72>;
			pinctrl-34 = <0x73>;
			pinctrl-35 = <0x74>;
			pinctrl-36 = <0x75>;
			pinctrl-4 = <0x55>;
			pinctrl-5 = <0x56>;
			pinctrl-6 = <0x57>;
			pinctrl-7 = <0x58>;
			pinctrl-8 = <0x59>;
			pinctrl-9 = <0x5a>;
			pinctrl-names = "pin_default\0bpibus0_pin_high\0bpibus0_pin_low\0bpibus1_pin_high\0bpibus1_pin_low\0bpibus2_pin_high\0bpibus2_pin_low\0bpibus3_pin_high\0bpibus3_pin_low\0bpibus4_pin_high\0bpibus4_pin_low\0bpibus5_pin_high\0bpibus5_pin_low\0bpibus6_pin_high\0bpibus6_pin_low\0bpibus7_pin_high\0bpibus7_pin_low\0bpibus8_pin_high\0bpibus8_pin_low\0bpibus9_pin_high\0bpibus9_pin_low\0bpibus10_pin_high\0bpibus10_pin_low\0bpibus11_pin_high\0bpibus11_pin_low\0bpibus12_pin_high\0bpibus12_pin_low\0bpibus13_pin_high\0bpibus13_pin_low\0bpibus14_pin_high\0bpibus14_pin_low\0bpibus15_pin_high\0bpibus15_pin_low\0bpibus16_pin_high\0bpibus16_pin_low\0bpibus17_pin_high\0bpibus17_pin_low";
			status = "okay";
		};
	};

	fragment@32 {
		target = <0xffffffff>;

		__overlay__ {

			adc_channel@ {
				compatible = "mediatek,adc_channel";
				mediatek,adc_fdd_rf_params_dynamic_custom_ch = <0x02>;
				mediatek,temperature0 = <0x00>;
				mediatek,temperature1 = <0x01>;
				status = "okay";
			};
		};
	};

	fragment@33 {
		target = <0xffffffff>;

		__overlay__ {
			mediatek,clkbuf-config = <0x02 0x01 0x01 0x02 0x00 0x00 0x00>;
			mediatek,clkbuf-driving-current = <0x01 0x01 0x01 0x01 0x01 0x01 0x01>;
			mediatek,clkbuf-quantity = <0x07>;
			status = "okay";
		};
	};

	fragment@34 {
		target = <0xffffffff>;

		__overlay__ {
			#address-cells = <0x01>;
			#size-cells = <0x00>;
			clock-frequency = <0x61a80>;
			mediatek,use-open-drain;

			cap_touch@5d {
				compatible = "mediatek,cap_touch";
				linux,phandle = <0x7e>;
				phandle = <0x7e>;
				reg = <0x5d>;
				status = "okay";
			};
		};
	};

	fragment@35 {
		target = <0xffffffff>;

		__overlay__ {
			#address-cells = <0x01>;
			#size-cells = <0x00>;
			clock-frequency = <0x61a80>;
			mediatek,use-open-drain;

			alsps@51 {
				compatible = "mediatek,alsps";
				interrupt-parent = <0xffffffff>;
				interrupts = <0x06 0x08 0x06 0x00>;
				linux,phandle = <0x81>;
				phandle = <0x81>;
				reg = <0x51>;
				status = "okay";
			};

			gsensor@4c {
				compatible = "mediatek,gsensor";
				linux,phandle = <0x7f>;
				phandle = <0x7f>;
				reg = <0x4c>;
				status = "okay";
			};

			gyro@6b {
				compatible = "mediatek,gyro";
				linux,phandle = <0x82>;
				phandle = <0x82>;
				reg = <0x6b>;
				status = "okay";
			};

			i2c_lcd_bias@7c {
				compatible = "mediatek,i2c_lcd_bias";
				linux,phandle = <0x83>;
				phandle = <0x83>;
				reg = <0x7c>;
				status = "okay";
			};

			msensor@0c {
				compatible = "mediatek,msensor";
				linux,phandle = <0x80>;
				phandle = <0x80>;
				reg = <0x0c>;
				status = "okay";
			};
		};
	};

	fragment@36 {
		target = <0xffffffff>;

		__overlay__ {
			#address-cells = <0x01>;
			#size-cells = <0x00>;
			clock-frequency = <0x61a80>;
			mediatek,use-open-drain;

			camera_main@1a {
				compatible = "mediatek,camera_main";
				linux,phandle = <0x84>;
				phandle = <0x84>;
				reg = <0x1a>;
				status = "okay";
			};

			camera_main_af@0c {
				compatible = "mediatek,camera_main_af";
				linux,phandle = <0x86>;
				phandle = <0x86>;
				reg = <0x0c>;
				status = "okay";
			};

			camera_main_eeprom@50 {
				compatible = "mediatek,camera_main_eeprom";
				linux,phandle = <0x85>;
				phandle = <0x85>;
				reg = <0x50>;
				status = "okay";
			};
		};
	};

	fragment@37 {
		target = <0xffffffff>;

		__overlay__ {
			#address-cells = <0x01>;
			#size-cells = <0x00>;
			clock-frequency = <0x61a80>;
			mediatek,use-open-drain;

			nfc@08 {
				compatible = "mediatek,nfc";
				linux,phandle = <0x87>;
				phandle = <0x87>;
				reg = <0x08>;
				status = "okay";
			};
		};
	};

	fragment@38 {
		target = <0xffffffff>;

		__overlay__ {
			#address-cells = <0x01>;
			#size-cells = <0x00>;
			clock-frequency = <0x61a80>;
			mediatek,use-open-drain;

			camera_sub@2d {
				compatible = "mediatek,camera_sub";
				linux,phandle = <0x88>;
				phandle = <0x88>;
				reg = <0x2d>;
				status = "okay";
			};

			camera_sub_eeprom@52 {
				compatible = "mediatek,camera_sub_eeprom";
				linux,phandle = <0x89>;
				phandle = <0x89>;
				reg = <0x52>;
				status = "okay";
			};
		};
	};

	fragment@39 {
		target = <0xffffffff>;

		__overlay__ {
			#address-cells = <0x01>;
			#size-cells = <0x00>;
			clock-frequency = <0x61a80>;
			mediatek,use-open-drain;

			camera_main_two@20 {
				compatible = "mediatek,camera_main_two";
				linux,phandle = <0x8a>;
				phandle = <0x8a>;
				reg = <0x20>;
				status = "okay";
			};
		};
	};

	fragment@4 {
		target = <0xffffffff>;

		__overlay__ {
			atag,videolfb-fb_base_h = <0x00>;
			atag,videolfb-fb_base_l = "^`P";
			atag,videolfb-fps = <0x1770>;
			atag,videolfb-islcm_inited = <0x00>;
			atag,videolfb-islcmfound = <0x01>;
			atag,videolfb-lcmname = "nt35695B_fhd_dsi_cmd_auo_rt5081_drv";
			atag,videolfb-vramSize = <0x17bb000>;
		};
	};

	fragment@40 {
		target = <0xffffffff>;

		__overlay__ {
			#address-cells = <0x01>;
			#size-cells = <0x00>;
			clock-frequency = <0x61a80>;
			mediatek,use-open-drain;
		};
	};

	fragment@41 {
		target = <0xffffffff>;

		__overlay__ {
			#address-cells = <0x01>;
			#size-cells = <0x00>;
			clock-frequency = <0x61a80>;
			mediatek,use-open-drain;
		};
	};

	fragment@42 {
		target = <0xffffffff>;

		__overlay__ {
			#address-cells = <0x01>;
			#size-cells = <0x00>;
			clock-frequency = <0x61a80>;
			mediatek,use-open-drain;
		};
	};

	fragment@43 {
		target = <0xffffffff>;

		__overlay__ {
			#address-cells = <0x01>;
			#size-cells = <0x00>;
			clock-frequency = <0x61a80>;
			mediatek,use-open-drain;
		};
	};

	fragment@44 {
		target = <0xffffffff>;

		__overlay__ {
			GPIO_FDD_BAND_SUPPORT_DETECT_1ST_PIN = <0xffffffff 0x35 0x00>;
			GPIO_SIM1_HOT_PLUG = <0xffffffff 0x2f 0x00>;
			GPIO_SIM1_SCLK = <0xffffffff 0x26 0x00>;
			GPIO_SIM1_SIO = <0xffffffff 0x28 0x00>;
			GPIO_SIM1_SRST = <0xffffffff 0x27 0x00>;
			GPIO_SIM2_HOT_PLUG = <0xffffffff 0x2e 0x00>;
			GPIO_SIM2_SCLK = <0xffffffff 0x25 0x00>;
			GPIO_SIM2_SIO = <0xffffffff 0x23 0x00>;
			GPIO_SIM2_SRST = <0xffffffff 0x24 0x00>;
		};
	};

	fragment@45 {
		target = <0xffffffff>;

		__overlay__ {
			gpio_init_default = <0x00 0x00 0x00 0x00 0x01 0x01 0x01 0x01 0x00 0x00 0x00 0x01 0x00 0x01 0x02 0x00 0x00 0x00 0x01 0x00 0x01 0x03 0x00 0x00 0x00 0x00 0x00 0x01 0x04 0x00 0x00 0x00 0x01 0x01 0x00 0x05 0x00 0x01 0x00 0x01 0x00 0x00 0x06 0x00 0x00 0x00 0x01 0x01 0x00 0x07 0x00 0x01 0x00 0x01 0x00 0x00 0x08 0x00 0x01 0x00 0x01 0x00 0x00 0x09 0x00 0x00 0x00 0x01 0x01 0x00 0x0a 0x00 0x00 0x00 0x01 0x00 0x00 0x0b 0x00 0x00 0x00 0x01 0x01 0x00 0x0c 0x00 0x01 0x00 0x01 0x00 0x00 0x0d 0x03 0x00 0x00 0x01 0x00 0x00 0x0e 0x03 0x01 0x00 0x00 0x00 0x00 0x0f 0x03 0x01 0x00 0x00 0x00 0x00 0x10 0x03 0x01 0x00 0x00 0x00 0x00 0x11 0x00 0x00 0x00 0x01 0x00 0x00 0x12 0x00 0x00 0x00 0x01 0x00 0x00 0x13 0x00 0x00 0x00 0x01 0x00 0x00 0x14 0x00 0x00 0x00 0x01 0x00 0x00 0x15 0x00 0x00 0x00 0x01 0x00 0x00 0x16 0x00 0x00 0x00 0x01 0x00 0x00 0x17 0x00 0x00 0x00 0x01 0x00 0x00 0x18 0x00 0x00 0x00 0x01 0x00 0x00 0x19 0x00 0x00 0x00 0x01 0x00 0x00 0x1a 0x00 0x00 0x00 0x01 0x00 0x00 0x1b 0x00 0x00 0x00 0x01 0x00 0x00 0x1c 0x00 0x00 0x00 0x01 0x00 0x00 0x1d 0x01 0x00 0x00 0x01 0x00 0x01 0x1e 0x01 0x00 0x00 0x01 0x00 0x01 0x1f 0x01 0x00 0x00 0x01 0x00 0x01 0x20 0x01 0x00 0x00 0x01 0x00 0x01 0x21 0x01 0x00 0x00 0x01 0x00 0x01 0x22 0x01 0x00 0x00 0x01 0x00 0x01 0x23 0x01 0x00 0x00 0x01 0x01 0x00 0x24 0x01 0x00 0x00 0x00 0x00 0x00 0x25 0x01 0x00 0x00 0x00 0x00 0x00 0x26 0x01 0x00 0x00 0x00 0x00 0x00 0x27 0x01 0x00 0x00 0x00 0x00 0x00 0x28 0x01 0x00 0x00 0x01 0x01 0x00 0x29 0x00 0x00 0x00 0x01 0x00 0x00 0x2a 0x00 0x00 0x00 0x01 0x00 0x00 0x2b 0x01 0x00 0x00 0x00 0x00 0x00 0x2c 0x01 0x00 0x00 0x01 0x00 0x00 0x2d 0x01 0x01 0x00 0x00 0x00 0x00 0x2e 0x01 0x00 0x00 0x01 0x01 0x00 0x2f 0x01 0x00 0x00 0x01 0x01 0x00 0x30 0x01 0x00 0x00 0x01 0x01 0x01 0x31 0x01 0x00 0x00 0x01 0x01 0x01 0x32 0x01 0x00 0x00 0x01 0x01 0x01 0x33 0x01 0x00 0x00 0x01 0x01 0x01 0x34 0x01 0x00 0x00 0x01 0x00 0x00 0x35 0x00 0x00 0x00 0x01 0x00 0x00 0x36 0x01 0x00 0x00 0x01 0x00 0x00 0x37 0x01 0x00 0x00 0x01 0x00 0x00 0x38 0x00 0x00 0x00 0x01 0x00 0x00 0x39 0x01 0x00 0x00 0x01 0x00 0x00 0x3a 0x00 0x00 0x00 0x01 0x00 0x00 0x3b 0x01 0x00 0x00 0x01 0x00 0x00 0x3c 0x01 0x00 0x00 0x01 0x00 0x00 0x3d 0x01 0x00 0x00 0x01 0x00 0x00 0x3e 0x01 0x00 0x00 0x01 0x00 0x00 0x3f 0x01 0x00 0x00 0x01 0x00 0x00 0x40 0x01 0x00 0x00 0x01 0x00 0x00 0x41 0x01 0x00 0x00 0x01 0x00 0x00 0x42 0x01 0x00 0x00 0x01 0x00 0x00 0x43 0x01 0x00 0x00 0x01 0x00 0x00 0x44 0x01 0x00 0x00 0x01 0x00 0x00 0x45 0x01 0x00 0x00 0x01 0x00 0x00 0x46 0x01 0x00 0x00 0x01 0x00 0x00 0x47 0x01 0x00 0x00 0x01 0x00 0x00 0x48 0x01 0x00 0x00 0x01 0x00 0x00 0x49 0x01 0x00 0x00 0x01 0x00 0x00 0x4a 0x01 0x00 0x00 0x01 0x00 0x00 0x4b 0x01 0x00 0x00 0x01 0x00 0x00 0x4c 0x01 0x00 0x00 0x01 0x00 0x00 0x4d 0x01 0x00 0x00 0x01 0x00 0x00 0x4e 0x01 0x00 0x00 0x01 0x00 0x00 0x4f 0x01 0x00 0x00 0x01 0x00 0x00 0x50 0x01 0x00 0x00 0x01 0x00 0x00 0x51 0x01 0x00 0x00 0x01 0x01 0x01 0x52 0x01 0x00 0x00 0x01 0x01 0x01 0x53 0x01 0x00 0x00 0x01 0x01 0x01 0x54 0x01 0x00 0x00 0x01 0x01 0x01 0x55 0x01 0x00 0x00 0x01 0x00 0x00 0x56 0x01 0x00 0x00 0x01 0x00 0x00 0x57 0x00 0x00 0x00 0x01 0x00 0x00 0x58 0x00 0x01 0x00 0x01 0x00 0x00 0x59 0x01 0x00 0x00 0x01 0x00 0x00 0x5a 0x02 0x00 0x00 0x00 0x00 0x00 0x5b 0x01 0x00 0x00 0x00 0x00 0x00 0x5c 0x01 0x00 0x00 0x00 0x00 0x00 0x5d 0x01 0x00 0x00 0x01 0x01 0x00 0x5e 0x01 0x00 0x00 0x01 0x01 0x00 0x5f 0x01 0x00 0x00 0x01 0x01 0x00 0x60 0x01 0x00 0x00 0x00 0x00 0x00 0x61 0x00 0x01 0x00 0x01 0x00 0x00 0x62 0x00 0x01 0x00 0x01 0x00 0x00 0x63 0x01 0x00 0x00 0x00 0x00 0x00 0x64 0x01 0x00 0x00 0x00 0x00 0x00 0x65 0x00 0x01 0x01 0x01 0x00 0x00 0x66 0x00 0x01 0x01 0x01 0x00 0x00 0x67 0x01 0x00 0x00 0x01 0x01 0x01 0x68 0x01 0x00 0x00 0x01 0x01 0x01 0x69 0x01 0x00 0x00 0x01 0x01 0x01 0x6a 0x01 0x00 0x00 0x01 0x01 0x01 0x6b 0x00 0x01 0x00 0x01 0x00 0x00 0x6c 0x01 0x00 0x00 0x00 0x00 0x00 0x6d 0x00 0x01 0x00 0x01 0x00 0x00 0x6e 0x00 0x00 0x00 0x01 0x01 0x00 0x6f 0x00 0x00 0x00 0x01 0x00 0x00 0x70 0x00 0x00 0x00 0x01 0x00 0x00 0x71 0x00 0x00 0x00 0x01 0x00 0x00 0x72 0x00 0x00 0x00 0x01 0x00 0x00 0x73 0x00 0x00 0x00 0x01 0x00 0x00 0x74 0x00 0x00 0x00 0x01 0x00 0x00 0x75 0x00 0x00 0x00 0x01 0x00 0x00 0x76 0x00 0x00 0x00 0x01 0x00 0x00 0x77 0x00 0x00 0x00 0x01 0x00 0x00 0x78 0x00 0x00 0x00 0x01 0x00 0x00 0x79 0x00 0x00 0x00 0x01 0x00 0x00 0x86 0x01 0x00 0x00 0x01 0x00 0x01 0x87 0x01 0x00 0x00 0x00 0x00 0x00 0x88 0x01 0x00 0x00 0x00 0x00 0x00 0x89 0x01 0x00 0x00 0x00 0x00 0x00 0x8a 0x01 0x00 0x00 0x00 0x00 0x00 0x8b 0x01 0x00 0x00 0x00 0x00 0x00 0x8c 0x01 0x00 0x00 0x01 0x00 0x00 0x8d 0x01 0x00 0x00 0x01 0x00 0x00 0x8e 0x01 0x00 0x00 0x01 0x00 0x00 0x8f 0x01 0x00 0x00 0x01 0x00 0x00 0x90 0x01 0x00 0x00 0x01 0x00 0x00 0x91 0x01 0x00 0x00 0x00 0x00 0x00 0x92 0x01 0x00 0x00 0x01 0x00 0x00 0x93 0x01 0x00 0x00 0x00 0x00 0x00 0x94 0x01 0x00 0x00 0x00 0x00 0x00 0x95 0x01 0x00 0x00 0x00 0x00 0x00 0x96 0x00 0x01 0x01 0x01 0x00 0x00 0x97 0x00 0x00 0x00 0x01 0x00 0x00 0x98 0x00 0x00 0x00 0x01 0x00 0x00 0x99 0x00 0x01 0x01 0x01 0x00 0x00 0x9a 0x00 0x00 0x00 0x01 0x00 0x00 0x9b 0x01 0x00 0x00 0x00 0x00 0x00 0x9c 0x01 0x00 0x00 0x00 0x00 0x00 0x9d 0x01 0x00 0x00 0x00 0x00 0x00 0x9e 0x01 0x00 0x00 0x00 0x00 0x00 0x9f 0x00 0x01 0x00 0x01 0x00 0x00 0xa0 0x00 0x00 0x00 0x01 0x00 0x00 0xa1 0x01 0x00 0x00 0x01 0x01 0x01 0xa2 0x01 0x00 0x00 0x01 0x01 0x01 0xa3 0x00 0x00 0x00 0x01 0x00 0x00 0xa4 0x00 0x01 0x00 0x01 0x00 0x00 0xa5 0x00 0x01 0x00 0x01 0x00 0x00 0xa6 0x00 0x01 0x00 0x01 0x00 0x00 0xa7 0x00 0x01 0x00 0x01 0x00 0x00 0xa8 0x00 0x01 0x00 0x01 0x00 0x00 0xa9 0x00 0x00 0x00 0x01 0x00 0x00 0xaa 0x00 0x00 0x00 0x01 0x00 0x00 0xab 0x00 0x01 0x00 0x01 0x00 0x00 0xac 0x00 0x01 0x00 0x01 0x00 0x00 0xad 0x00 0x01 0x00 0x01 0x00 0x00 0xae 0x00 0x01 0x01 0x01 0x00 0x00 0xaf 0x00 0x01 0x00 0x01 0x00 0x00 0xb0 0x00 0x00 0x00 0x01 0x00 0x00 0xb1 0x00 0x00 0x00 0x01 0x00 0x00 0xb2 0x00 0x01 0x00 0x01 0x00 0x00 0xb3 0x00 0x00 0x00 0x01 0x00 0x00>;
		};
	};

	fragment@46 {
		target = <0xffffffff>;

		__overlay__ {
			interrupt-parent = <0xffffffff>;
			interrupts = <0x00 0x02 0x00 0x00>;
			status = "okay";
		};
	};

	fragment@47 {
		target = <0xffffffff>;

		__overlay__ {
			interrupt-parent = <0xffffffff>;
			interrupts = <0x01 0x04 0x01 0x00>;
			status = "okay";
		};
	};

	fragment@48 {
		target = <0xffffffff>;

		__overlay__ {
			deb-gpios = <0xffffffff 0x09 0x00>;
			debounce = <0x3e80>;
			interrupt-parent = <0xffffffff>;
			interrupts = <0x09 0x08 0x09 0x00>;
			status = "okay";
		};
	};

	fragment@49 {
		target = <0xffffffff>;

		__overlay__ {
			interrupt-parent = <0xffffffff>;
			interrupts = <0x0b 0x08 0x0b 0x00>;
			status = "okay";
		};
	};

	fragment@5 {
		target = <0xffffffff>;

		__overlay__ {

			cust_accel@0 {
				compatible = "mediatek,mc3410";
				direction = <0x05>;
				firlen = <0x00>;
				i2c_addr = <0x4c 0x00 0x00 0x00>;
				i2c_num = <0x01>;
				is_batch_supported = <0x00>;
				power_id = <0xffff>;
				power_vol = <0x00>;
			};

			cust_accel@1 {
				compatible = "mediatek,lsm6ds3_acc";
				direction = <0x05>;
				firlen = <0x00>;
				i2c_addr = <0x6b 0x00 0x00 0x00>;
				i2c_num = <0x01>;
				is_batch_supported = <0x00>;
				power_id = <0xffff>;
				power_vol = <0x00>;
			};

			cust_accel@2 {
				compatible = "mediatek,icm206xxg";
				direction = <0x05>;
				firlen = <0x00>;
				i2c_addr = <0x69 0x00 0x00 0x00>;
				i2c_num = <0x01>;
				is_batch_supported = <0x00>;
				power_id = <0xffff>;
				power_vol = <0x00>;
			};

			cust_alsps@0 {
				als_level = <0x00 0x148 0x35d 0x561 0xc35 0x1e29 0x1e57 0x314d 0x5a16 0x6f0e 0x81fa 0xb80c 0xe15e 0xe15e 0xffff>;
				als_value = <0x00 0x85 0x130 0x1f6 0x3ec 0x7d5 0xbf2 0x138d 0x1f48 0x271a 0x2ee0 0x3e80 0x4e20 0x4e20 0x4e20 0x4e20>;
				compatible = "mediatek,cm36558";
				i2c_addr = <0x51 0x00 0x00 0x00>;
				i2c_num = <0x01>;
				is_batch_supported_als = <0x00>;
				is_batch_supported_ps = <0x00>;
				polling_mode_als = <0x01>;
				polling_mode_ps = <0x00>;
				power_id = <0xffff>;
				power_vol = <0x00>;
				ps_threshold_high = <0x1a>;
				ps_threshold_low = <0x15>;
			};

			cust_alsps@1 {
				als_level = <0x14 0x2d 0x46 0x5a 0x96 0x12c 0x1f4 0x2bc 0x47e 0x8ca 0x1194 0x1f40 0x3a98 0x7530 0xc350>;
				als_value = <0x0a 0x1e 0x3c 0x50 0x64 0xc8 0x190 0x258 0x320 0x5dc 0xbb8 0x1770 0x2710 0x4e20 0x9c40 0xea60>;
				compatible = "mediatek,epl259x";
				i2c_addr = <0x49 0x00 0x00 0x00>;
				i2c_num = <0x01>;
				is_batch_supported_als = <0x00>;
				is_batch_supported_ps = <0x00>;
				polling_mode_als = <0x01>;
				polling_mode_ps = <0x00>;
				power_id = <0xffff>;
				power_vol = <0x00>;
				ps_threshold_high = <0x320>;
				ps_threshold_low = <0x1f4>;
			};

			cust_alsps@2 {
				als_level = <0x0d 0x14 0x24 0x3b 0x52 0x84 0xcd 0x111 0x1f4 0x34d 0x470 0x609 0x93c 0x122f 0x1b46>;
				als_value = <0x00 0x0a 0x32 0x64 0x96 0xc8 0xfa 0x1c2 0x2bc 0x3a2 0x4e2 0x6a4 0xa28 0x1400 0x1e00 0x2800>;
				compatible = "mediatek,stk3x1x";
				i2c_addr = <0x48 0x00 0x00 0x00>;
				i2c_num = <0x01>;
				is_batch_supported_als = <0x00>;
				is_batch_supported_ps = <0x00>;
				polling_mode_als = <0x01>;
				polling_mode_ps = <0x00>;
				power_id = <0xffff>;
				power_vol = <0x00>;
				ps_threshold_high = <0x6a4>;
				ps_threshold_low = <0x5dc>;
			};

			cust_baro@0 {
				compatible = "mediatek,bmp280new";
				direction = <0x00>;
				firlen = <0x20>;
				i2c_num = <0x01>;
				is_batch_supported = <0x00>;
				power_id = <0xffff>;
				power_vol = <0x00>;
			};

			cust_gyro@0 {
				compatible = "mediatek,itg1010";
				direction = <0x05>;
				firlen = <0x00>;
				i2c_num = <0x01>;
				is_batch_supported = <0x00>;
				power_id = <0xffff>;
				power_vol = <0x00>;
			};

			cust_gyro@1 {
				compatible = "mediatek,icm206xxgy";
				direction = <0x05>;
				firlen = <0x00>;
				i2c_addr = <0x69 0x00 0x00 0x00>;
				i2c_num = <0x01>;
				is_batch_supported = <0x00>;
				power_id = <0xffff>;
				power_vol = <0x00>;
			};

			cust_gyro@2 {
				compatible = "mediatek,lsm6ds3_gyro";
				direction = <0x05>;
				firlen = <0x00>;
				i2c_addr = <0x6b 0x00 0x00 0x00>;
				i2c_num = <0x01>;
				is_batch_supported = <0x00>;
				power_id = <0xffff>;
				power_vol = <0x00>;
			};

			cust_mag@0 {
				compatible = "mediatek,af6133";
				direction = <0x01>;
				i2c_addr = <0x0c 0x00 0x00 0x00>;
				i2c_num = <0x01>;
				is_batch_supported = <0x00>;
				power_id = <0xffff>;
				power_vol = <0x00>;
			};

			led@0 {
				compatible = "mediatek,red";
				data = <0x01>;
				led_mode = <0x04>;
				linux,phandle = <0x76>;
				phandle = <0x76>;
				pwm_config = <0x00 0x00 0x00 0x00 0x00>;
			};

			led@1 {
				compatible = "mediatek,green";
				data = <0x01>;
				led_mode = <0x04>;
				linux,phandle = <0x77>;
				phandle = <0x77>;
				pwm_config = <0x00 0x00 0x00 0x00 0x00>;
			};

			led@2 {
				compatible = "mediatek,blue";
				data = <0x01>;
				led_mode = <0x04>;
				linux,phandle = <0x78>;
				phandle = <0x78>;
				pwm_config = <0x00 0x00 0x00 0x00 0x00>;
			};

			led@3 {
				compatible = "mediatek,jogball-backlight";
				data = <0x01>;
				led_mode = <0x00>;
				linux,phandle = <0x79>;
				phandle = <0x79>;
				pwm_config = <0x00 0x00 0x00 0x00 0x00>;
			};

			led@4 {
				compatible = "mediatek,keyboard-backlight";
				data = <0x01>;
				led_mode = <0x00>;
				linux,phandle = <0x7a>;
				phandle = <0x7a>;
				pwm_config = <0x00 0x00 0x00 0x00 0x00>;
			};

			led@5 {
				compatible = "mediatek,button-backlight";
				data = <0x01>;
				led_mode = <0x00>;
				linux,phandle = <0x7b>;
				phandle = <0x7b>;
				pwm_config = <0x00 0x00 0x00 0x00 0x00>;
			};

			led@6 {
				compatible = "mediatek,lcd-backlight";
				data = <0x01>;
				led_mode = <0x05>;
				linux,phandle = <0x7c>;
				phandle = <0x7c>;
				pwm_config = <0x00 0x03 0x00 0x00 0x00>;
			};

			vibrator@0 {
				compatible = "mediatek,vibrator";
				linux,phandle = <0x7d>;
				phandle = <0x7d>;
				vib_limit = <0x09>;
				vib_timer = <0x19>;
				vib_vol = <0x09>;
			};
		};
	};

	fragment@50 {
		target = <0xffffffff>;

		__overlay__ {
			interrupt-parent = <0xffffffff>;
			interrupts = <0x2c 0x01 0x2c 0x01>;
			status = "okay";
		};
	};

	fragment@51 {
		target = <0xffffffff>;

		__overlay__ {
			interrupt-parent = <0xffffffff>;
			interrupts = <0x6e 0x08 0x6e 0x00>;
			status = "okay";
		};
	};

	fragment@52 {
		target = <0xffffffff>;

		__overlay__ {
			interrupt-parent = <0xffffffff>;
			interrupts = <0x90 0x04 0x90 0x01>;
			status = "okay";
		};
	};

	fragment@53 {
		target = <0xffffffff>;

		__overlay__ {
			compatible = "mediatek,md1_sim1_hot_plug_eint-eint";
			debounce = <0x00 0x186a0>;
			dedicated = <0x00 0x00>;
			interrupts = <0x00 0x04>;
			sockettype = <0x00 0x00>;
			src_pin = <0x00 0x01>;
			status = "okay";
		};
	};

	fragment@54 {
		target = <0xffffffff>;

		__overlay__ {
			compatible = "mediatek,md1_sim2_hot_plug_eint-eint";
			debounce = <0x01 0x186a0>;
			dedicated = <0x01 0x00>;
			interrupts = <0x01 0x04>;
			sockettype = <0x01 0x00>;
			src_pin = <0x01 0x02>;
			status = "okay";
		};
	};

	fragment@55 {
		target = <0xffffffff>;

		__overlay__ {
			regulator-default-on = <0x01>;
			regulator-name = "vcama";
			status = "okay";
		};
	};

	fragment@56 {
		target = <0xffffffff>;

		__overlay__ {
			regulator-default-on = <0x01>;
			regulator-name = "vsim1";
			status = "okay";
		};
	};

	fragment@57 {
		target = <0xffffffff>;

		__overlay__ {
			regulator-default-on = <0x01>;
			regulator-name = "vsim2";
			status = "okay";
		};
	};

	fragment@58 {
		target = <0xffffffff>;

		__overlay__ {
			regulator-default-on = <0x01>;
			regulator-name = "vcamd";
			status = "okay";
		};
	};

	fragment@59 {
		target = <0xffffffff>;

		__overlay__ {
			regulator-default-on = <0x01>;
			regulator-name = "vcamio";
			status = "okay";
		};
	};

	fragment@6 {
		target = <0xffffffff>;

		__overlay__ {

			alsps@51 {
				als_level = <0x00 0x148 0x35d 0x561 0xc35 0x1e29 0x1e57 0x314d 0x5a16 0x6f0e 0x81fa 0xb80c 0xe15e 0xe15e 0xffff>;
				als_value = <0x00 0x85 0x130 0x1f6 0x3ec 0x7d5 0xbf2 0x138d 0x1f48 0x271a 0x2ee0 0x3e80 0x4e20 0x4e20 0x4e20 0x4e20>;
				i2c_addr = <0x51 0x00 0x00 0x00>;
				i2c_num = <0x01>;
				is_batch_supported_als = <0x00>;
				is_batch_supported_ps = <0x00>;
				pinctrl-0 = <0x11>;
				pinctrl-1 = <0x12>;
				pinctrl-names = "pin_default\0pin_cfg";
				polling_mode_als = <0x01>;
				polling_mode_ps = <0x00>;
				power_id = <0xffff>;
				power_vol = <0x00>;
				ps_threshold_high = <0x1a>;
				ps_threshold_low = <0x15>;
				status = "okay";
			};

			barometer@77 {
				direction = <0x00>;
				firlen = <0x20>;
				i2c_addr = <0x77 0x00 0x00 0x00>;
				i2c_num = <0x01>;
				is_batch_supported = <0x00>;
				power_id = <0xffff>;
				power_vol = <0x00>;
			};

			gsensor@4c {
				direction = <0x06>;
				firlen = <0x10>;
				i2c_num = <0x01>;
				is_batch_supported = <0x01>;
				power_id = <0xffff>;
				power_vol = <0x00>;
			};

			gyro@6b {
				direction = <0x05>;
				firlen = <0x00>;
				i2c_addr = <0x6b 0x00 0x00 0x00>;
				i2c_num = <0x01>;
				is_batch_supported = <0x00>;
				power_id = <0xffff>;
				power_vol = <0x00>;
			};

			msensor@0c {
				direction = <0x08>;
				i2c_addr = <0x0d 0x00 0x00 0x00>;
				i2c_num = <0x01>;
				is_batch_supported = <0x00>;
				power_id = <0xffff>;
				power_vol = <0x00>;
			};
		};
	};

	fragment@60 {
		target = <0xffffffff>;

		__overlay__ {
			regulator-default-on = <0x01>;
			regulator-name = "vldo28";
			status = "okay";
		};
	};

	fragment@61 {
		target = <0xffffffff>;

		__overlay__ {
			status = "okay";
			vcama-supply = <0xffffffff>;
			vcama_main2-supply = <0xffffffff>;
			vcama_sub-supply = <0xffffffff>;
			vcamaf-supply = <0xffffffff>;
			vcamaf_main2-supply = <0xffffffff>;
			vcamaf_sub-supply = <0xffffffff>;
			vcamd-supply = <0xffffffff>;
			vcamd_main2-supply = <0xffffffff>;
			vcamd_sub-supply = <0xffffffff>;
			vcamio-supply = <0xffffffff>;
			vcamio_main2-supply = <0xffffffff>;
			vcamio_sub-supply = <0xffffffff>;
		};
	};

	fragment@62 {
		target = <0xffffffff>;

		__overlay__ {
			status = "okay";
			vtouch-supply = <0xffffffff>;
		};
	};

	fragment@63 {
		target = <0xffffffff>;

		__overlay__ {
			mediatek,kpd-hw-dl-key0 = <0x00>;
			mediatek,kpd-hw-dl-key1 = <0x01>;
			mediatek,kpd-hw-dl-key2 = <0x08>;
			mediatek,kpd-hw-factory-key = <0x01>;
			mediatek,kpd-hw-init-map = <0x73 0x72 0x00 0x00 0x00 0x00 0x00 0x00 0x00 0x00 0x00 0x00 0x00 0x00 0x00 0x00 0x00 0x00 0x00 0x00 0x00 0x00 0x00 0x00 0x00 0x00 0x00 0x00 0x00 0x00 0x00 0x00 0x00 0x00 0x00 0x00 0x00 0x00 0x00 0x00 0x00 0x00 0x00 0x00 0x00 0x00 0x00 0x00 0x00 0x00 0x00 0x00 0x00 0x00 0x00 0x00 0x00 0x00 0x00 0x00 0x00 0x00 0x00 0x00 0x00 0x00 0x00 0x00 0x00 0x00 0x00 0x00>;
			mediatek,kpd-hw-map-num = <0x48>;
			mediatek,kpd-hw-pwrkey = <0x08>;
			mediatek,kpd-hw-recovery-key = <0x00>;
			mediatek,kpd-hw-rstkey = <0x11>;
			mediatek,kpd-key-debounce = <0x400>;
			mediatek,kpd-pwkey-gpio-din = <0x00>;
			mediatek,kpd-pwrkey-eint-gpio = <0x00>;
			mediatek,kpd-sw-pwrkey = <0x74>;
			mediatek,kpd-sw-rstkey = <0x66>;
			mediatek,kpd-use-extend-type = <0x00>;
			status = "okay";
		};
	};

	fragment@7 {
		target = <0xffffffff>;

		__overlay__ {
			#address-cells = <0x01>;
			#size-cells = <0x00>;
			clock-frequency = <0x61a80>;

			mtk-usb@60 {
				compatible = "mediatek,mtk-usb";
				reg = <0x60>;
				status = "okay";
			};
		};
	};

	fragment@8 {
		target = <0xffffffff>;

		__overlay__ {
			#address-cells = <0x01>;
			#size-cells = <0x00>;
			clock-frequency = <0x61a80>;
			mediatek,use-open-drain;

			eta6937@6a {
				compatible = "mediatek,eta6937";
				reg = <0x6a>;
				status = "okay";
			};
		};
	};

	fragment@9 {
		target = <0xffffffff>;

		__overlay__ {

			ext_buck_vgpu@55 {
				regulator-max-microvolt = <0x13d620>;
				regulator-min-microvolt = <0x493e0>;
				regulator-name = "ext_buck_vgpu";
				vsel_pin = <0x02>;
			};
		};
	};
};
